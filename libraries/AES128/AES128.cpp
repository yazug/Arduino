/*
 * AES
 */
#include <avr/pgmspace.h>

#include "AES128.h"

/* Sbox Lookup Table */
PROGMEM const byte AES128::Sbox[256] = {
    0x63, 0x7c, 0x77, 0x7b, 0xf2, 0x6b, 0x6f, 0xc5,
    0x30, 0x01, 0x67, 0x2b, 0xfe, 0xd7, 0xab, 0x76,
    0xca, 0x82, 0xc9, 0x7d, 0xfa, 0x59, 0x47, 0xf0,
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    0x41, 0x99, 0x2d, 0x0f, 0xb0, 0x54, 0xbb, 0x16
};
/* Inverse Sbox Lookup Table */
PROGMEM const byte AES128::inv_Sbox[256] = {
    0x52, 0x09, 0x6a, 0xd5, 0x30, 0x36, 0xa5, 0x38,
    0xbf, 0x40, 0xa3, 0x9e, 0x81, 0xf3, 0xd7, 0xfb,
    0x7c, 0xe3, 0x39, 0x82, 0x9b, 0x2f, 0xff, 0x87,
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    0xe1, 0x69, 0x14, 0x63, 0x55, 0x21, 0x0c, 0x7d
};


PROGMEM const byte AES128::rcon [] = {
	0x01, 0x02, 0x04, 0x08, 0x10, 0x20, 0x40, 0x80, 0x1b, 0x36, 0x6c, 0xd8, 0xab
};

AES128::AES128(const byte * skey) {
	memcpy((void*)codekey, (const void*)skey, 16);
}

void AES128::initKey() {
	memcpy((void*)key, (const void*)codekey, 16);
}

byte * AES128::encrypt(byte *message) {
	int i;

	memcpy((void*)state, (const void*)message,16);
	
	initKey();
	addRoundKey();

	for(i = 0; i < 9; i++) {
 		subBytes();
		shiftRows();
		mixColumns();
		computeKey(pgm_read_byte(rcon + i));
		addRoundKey();
	}

	subBytes();
	shiftRows();
	computeKey(pgm_read_byte(rcon + i));
	addRoundKey();

	memcpy((void*)message,(const void*)state, 16);	
	return message;
}

byte * AES128::decrypt(byte *message) {
	int i;
		
	memcpy((void*)state, (const void*)message, 16);
	
	initKey();
	/*Generate Round Keys*/
	/*
	for(i = 0; i < 10; i++) {
		computeKey(rcon[i], i+1);
	}
	*/
	
	inv_addRoundKey(10);
	inv_shiftRows();
	inv_subBytes();
	
	for(i = 0; i < 9; i++)
	{
		inv_addRoundKey(9-i);
		inv_mixColumns();
		inv_shiftRows();
		inv_subBytes();
	}
	
	inv_addRoundKey(0);
	memcpy((void*)message,(const void*)state,16);
	
	return message;
}


void AES128::addRoundKey() {
	int i;
	for(i=0; i < 16; i++) {
		state[i] ^= key[i];
	}
}


void AES128::inv_addRoundKey(int i) {
	computeKeyRound(i);
	addRoundKey();
}



/* subBytes
 * Table Lookup
 */
void AES128::subBytes() {
	int i;

	for(i = 0; i < 16; i++) {
		state[i] = pgm_read_byte(Sbox + state[i]);
	}
}

/* shiftRows                Before         After
 * Row 1: No change        0 4  8 12      0  4  8 12    
 * Row 2: Left Shift by 1  1 5  9 13  =>  5  9 13  1    
 * Row 3: Left Shift by 2  2 6 10 14     10 14  2  6   
 * Row 4: Left Shift by 3  3 7 11 15     15 3   7 11  
 */
void AES128::shiftRows() {
	byte temp;

	//Row 2
	temp = state[1]; state[1] = state[5]; state[5] = state[9];
    state[9] = state[13]; state[13] = temp;
	//Row 3
	temp = state[10]; state[10] = state[2]; state[2] = temp;
	temp = state[14]; state[14] = state[6]; state[6] = temp;
	//Row 4
	temp = state[3]; state[3] = state[15]; state[15] = state[11]; 
    state[11] = state[7]; state[7] = temp;
}

/* subBytes
 * Table Lookup
 */
void AES128::inv_subBytes() {
	int i;
	
	for(i = 0; i < 16; i++) {
		state[i] = pgm_read_byte(inv_Sbox + state[i]);
	}
}

/* inv shiftRows              Before         After
 * Row 1: No change         0 4  8 12      0  4  8 12    
 * Row 2: Right Shift by 1  1 5  9 13  => 13  1  5  9    
 * Row 3: Right Shift by 2  2 6 10 14     10 14  2  6  
 * Row 4: Right Shift by 3  3 7 11 15      7 11 15  3  
 */
void AES128::inv_shiftRows() {
	byte temp;
	
	//Row 2
	temp = state[1]; state[1] = state[13]; state[13] = state[9];
	state[9] = state[5]; state[5] = temp;
	//Row 3
	temp = state[10]; state[10] = state[2]; state[2] = temp;
	temp = state[14]; state[14] = state[6]; state[6] = temp;
	//Row 4
	temp = state[3]; state[3] = state[7]; state[7] = state[11];
	state[11] = state[15]; state[15] = temp;
}


/* MixColumns Shortcut 
 * Vunerable to timing attack, must add nop
 */
byte AES128::xtime(byte x) {
	return (x & 0x80) ? ((x << 1) ^ 0x1b) : (x<<1);
}

/* Mix Columns */
void AES128::mixColumns() {
	byte i, a, b, c, d, e;
	
	/* Process a column at a time */
	for(i = 0; i < 16; i+=4) {
		a = state[i]; b = state[i+1]; c = state[i+2]; d = state[i+3];
		e = a ^ b ^ c ^ d;
		state[i]   ^= e ^ xtime(a^b);
		state[i+1] ^= e ^ xtime(b^c);
		state[i+2] ^= e ^ xtime(c^d);
		state[i+3] ^= e ^ xtime(d^a);
	}
}

/* Inverse Mix Column */
void AES128::inv_mixColumns() {
	byte i, a, b, c, d, e, x, y, z;
	
	/* Process a column at a time */
	for(i = 0; i < 16; i+=4)
	{
		a = state[i]; b = state[i+1]; c = state[i+2]; d = state[i+3];
		e = a ^ b ^ c ^ d;
		//Inverses
		z = xtime(e);
		x = e ^ xtime(xtime(z^a^c) );
		y = e ^ xtime(xtime(z^b^d) );
		state[i]   ^= x ^ xtime(a^b);
		state[i+1] ^= y ^ xtime(b^c);
		state[i+2] ^= x ^ xtime(c^d);
		state[i+3] ^= y ^ xtime(d^a);
	}
}

/* Compute a round of the key
 * 0 4  8 12
 * 1 5  9 13
 * 2 6 10 14
 * 3 7 11 15
 */
void AES128::computeKeyRound(int round) {
	int i;
	initKey();
	for (i=0; i < round; i++ ) {
		computeKey(pgm_read_byte(rcon+i));
	}
}

void AES128::computeKey(byte r) {
	byte buf0, buf1, buf2, buf3;
	buf0 = pgm_read_byte(Sbox + key[13]);
	buf1 = pgm_read_byte(Sbox + key[14]);
	buf2 = pgm_read_byte(Sbox + key[15]);
	buf3 = pgm_read_byte(Sbox + key[12]);

	key[0] ^= buf0 ^ r;
    key[1] ^= buf1;
    key[2] ^= buf2;
    key[3] ^= buf3;

	key[4] ^= key[0];
	key[5] ^= key[1];
	key[6] ^= key[2];
	key[7] ^= key[3];

	key[8]  ^= key[4];
	key[9]  ^= key[5];
	key[10] ^= key[6];
	key[11] ^= key[7];

	key[12] ^= key[8];
	key[13] ^= key[9];
	key[14] ^= key[10];
	key[15] ^= key[11];
}
